## libsk/Kconfig
```kconfig
#
# Copyright 2014, NICTA
#
# This software may be distributed and modified according to the terms of
# the BSD 2-Clause license. Note that NO WARRANTY is provided.
# See "LICENSE_BSD2.txt" for details.
#
# @TAG(NICTA_BSD)
#

config LIB_SK
    bool "Runtime library for the SK environment"
    default y
    help
        Provides the channels API for the separation kernel environment.
```

## libskc/Kconfig
```kconfig
#
# Copyright 2014, NICTA
#
# This software may be distributed and modified according to the terms of
# the BSD 2-Clause license. Note that NO WARRANTY is provided.
# See "LICENSE_BSD2.txt" for details.
#
# @TAG(NICTA_BSD)
#

config LIB_SK_C
    bool "Minimal libc for the SK environment"
    default y
    help
        An extremely minimal version of libc. Only the functionality necessary
        for the SIBR separation kernel environment is implemented.
```
